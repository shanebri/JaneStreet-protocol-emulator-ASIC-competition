`default_nettype none
// Debug transport only: SPI is generated by PIO assembly, not this serializer.
module spi_test_uart_tx #(
    parameter integer BIT_CYCLES = 434
) (
    input wire clk, reset, start,
    input wire [7:0] data,
    output wire tx,
    output reg busy
);
    reg [9:0] frame;
    reg [3:0] remaining;
    reg [15:0] ticks;
    assign tx = frame[0];
    always @(posedge clk) begin
        if (reset) begin
            frame <= 10'h3ff; busy <= 0; remaining <= 0; ticks <= 0;
        end else if (!busy) begin
            if (start) begin
                frame <= {1'b1, data, 1'b0};
                remaining <= 10; ticks <= 0; busy <= 1;
            end
        end else if (ticks == BIT_CYCLES - 1) begin
            ticks <= 0;
            frame <= {1'b1, frame[9:1]};
            remaining <= remaining - 1'b1;
            if (remaining == 1) busy <= 0;
        end else ticks <= ticks + 1'b1;
    end
endmodule
`default_nettype wire
